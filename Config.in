## configs/rockpis_defconfig
```kconfig
BR2_TARGET_GENERIC_HOSTNAME="rockpis"
BR2_TARGET_GENERIC_ISSUE="Welcome to a RockPi S OS"

# board/compiler target setup
BR2_aarch64=y
BR2_cortex_a35=y

# Rock-Chip repos - mostly for sdcard image generation
BR2_PACKAGE_RKBIN=y
BR2_PACKAGE_RKTOOLS=y
BR2_PACKAGE_RKDEVICE=y

# post build sdcard image generaton
BR2_ROOTFS_POST_BUILD_SCRIPT="$(BR2_EXTERNAL)/board/RK3308/post-build.sh"
BR2_ROOTFS_POST_IMAGE_SCRIPT="$(BR2_EXTERNAL)/board/RK3308/post-image.sh"
BR2_ROOTFS_POST_SCRIPT_ARGS="RK3308"

# Filesystems
BR2_TARGET_ROOTFS_EXT2=y
BR2_TARGET_ROOTFS_EXT2_4=y
BR2_TARGET_ROOTFS_EXT2_SIZE="250M"
BR2_PACKAGE_HOST_DOSFSTOOLS=y
BR2_PACKAGE_HOST_MTOOLS=y
BR2_PACKAGE_HOST_UBOOT_TOOLS=y
BR2_PACKAGE_HOST_GENIMAGE=y

# u-boot
BR2_TARGET_UBOOT=y
BR2_TARGET_UBOOT_BUILD_SYSTEM_KCONFIG=y
BR2_TARGET_UBOOT_USE_DEFCONFIG=y
BR2_TARGET_UBOOT_CUSTOM_GIT=y
BR2_TARGET_UBOOT_CUSTOM_REPO_URL="https://github.com/radxa/u-boot.git"
#BR2_TARGET_UBOOT_BOARD_DEFCONFIG="rockpi-s-rk3308"
#BR2_TARGET_UBOOT_CUSTOM_REPO_VERSION="stable-4.4-rockpis"
BR2_TARGET_UBOOT_BOARD_DEFCONFIG="rock-pi-s-rk3308"
BR2_TARGET_UBOOT_CUSTOM_REPO_VERSION="233a23e3ed0b3e5250253ee455c3c5df2080f99c"
BR2_TARGET_UBOOT_NEEDS_DTC=y
BR2_TARGET_UBOOT_FORMAT_BIN=y
BR2_TARGET_UBOOT_FORMAT_IMG=n
BR2_TARGET_UBOOT_SPL=n
BR2_TARGET_UBOOT_CONFIG_FRAGMENT_FILES="$(BR2_EXTERNAL)/board/RK3308/uboot.fragment"
BR2_PACKAGE_HOST_DTC=y

# linux
BR2_LINUX_KERNEL=y
BR2_LINUX_KERNEL_PATCH=""
BR2_LINUX_KERNEL_CUSTOM_LOGO_PATH=""
BR2_LINUX_KERNEL_DTS_SUPPORT=y
BR2_LINUX_KERNEL_IMAGE=y
BR2_LINUX_KERNEL_GZIP=y
BR2_LINUX_KERNEL_DTB_OVERLAY_SUPPORT=y

BR2_LINUX_KERNEL_CUSTOM_GIT=y
BR2_LINUX_KERNEL_CUSTOM_REPO_URL="https://github.com/radxa/kernel.git"
BR2_LINUX_KERNEL_CUSTOM_REPO_VERSION="stable-4.4-rockpis"
BR2_LINUX_KERNEL_INTREE_DTS_NAME="rockchip/rockpi-s-linux"
BR2_LINUX_KERNEL_DEFCONFIG="rk3308_linux"
BR2_PACKAGE_HOST_LINUX_HEADERS_CUSTOM_4_4=y

# configure the place to source patches, the busybox frament, overlays
BR2_GLOBAL_PATCH_DIR="$(BR2_EXTERNAL)/patches.rockpis"
BR2_PACKAGE_BUSYBOX_CONFIG_FRAGMENT_FILES="$(BR2_EXTERNAL)/board/RK3308/busybox.fragment"
BR2_ROOTFS_OVERLAY="$(BR2_EXTERNAL)/overlays"

# where to store downloads
BR2_DL_DIR="$(BASE_DIR)/../../buildroot.dl"

# An example kernel module and devicetree overlay
BR2_PACKAGE_EXAMPLE_MODULE_OVERLAY=y
BR2_LINUX_KERNEL_CONFIG_FRAGMENT_FILES=" $(BR2_EXTERNAL)/package/example-module-overlay/module-overlay-rk3308/kernel.fragment"

# networking
BR2_PACKAGE_OPENSSH=y
BR2_PACKAGE_OPENSSH_SERVER=y
BR2_PACKAGE_OPENSSH_CLIENT=y
BR2_SYSTEM_DHCP="eth0"
BR2_PACKAGE_AVAHI=y
BR2_PACKAGE_AVAHI_DAEMON=y

# bluetooth
BR2_TOOLCHAIN_BUILDROOT_WCHAR=y
BR2_PACKAGE_BLUEZ5_UTILS=y
BR2_PACKAGE_BLUEZ5_UTILS_CLIENT=y
BR2_PACKAGE_BLUEZ5_UTILS_DEPRECATED=y
BR2_PACKAGE_BLUEZ5_UTILS_PLUGINS_NFC=y
BR2_PACKAGE_RTK_HCIATTACH=y
```

## package/Config.in
```kconfig
menu "Packages"
source "$BR2_EXTERNAL_RK3308_PATH/package/libsox/Config.in"
#source "$BR2_EXTERNAL_RK3308_PATH/package/gtkiostream/Config.in"
source "$BR2_EXTERNAL_RK3308_PATH/package/rkbin/Config.in"
source "$BR2_EXTERNAL_RK3308_PATH/package/rkbin3588/Config.in"
source "$BR2_EXTERNAL_RK3308_PATH/package/rktools/Config.in"
source "$BR2_EXTERNAL_RK3308_PATH/package/rkdevice/Config.in"
source "$BR2_EXTERNAL_RK3308_PATH/package/rtk_hciattach/Config.in"
source "$BR2_EXTERNAL_RK3308_PATH/package/example-module-overlay/Config.in"
source "$BR2_EXTERNAL_RK3308_PATH/package/radxa-overlay/Config.in"
source "$BR2_EXTERNAL_RK3308_PATH/package/aes67-setup/Config.in"
endmenu
```

## package/dummy-soundcard/Config.in
```kconfig
config BR2_PACKAGE_DUMMY_SOUNDCARD
	bool "dummy-soundcard"
	depends on BR2_LINUX_KERNEL
	help
	  dummy soundcard module and devicetree overlay.

	  Lead in for developers to add modules and overlays which are out of tree.
```

## package/dummy-soundcard/module-dummy-soundcard/Kconfig
```kconfig
config SND_SOC_DUMMY_SOUNDCARD
        tristate "RK33xx platform machine driver example for a dummy soundcard"
        default n
        help
          ALSA machine driver for a dummy soundcard
```

## package/example-module-overlay/Config.in
```kconfig
config BR2_PACKAGE_EXAMPLE_MODULE_OVERLAY
	bool "example-module-overlay"
	depends on BR2_LINUX_KERNEL
	help
	  Example module overlay.

	  Lead in for developers to add modules and overlays which are out of tree.
```

## package/example-module-overlay/module-overlay-rk3308/Kconfig
```kconfig
config SND_SOC_MODULE_OVERLAY_RK3308
        tristate "RK3308 platform machine driver example"
        select SND_SOC_WM8731
        default n
        help
          Audio Injector ALSA machine driver for the rk3308 (e.g. RockPi s) platform.
```

## package/example-module-overlay/module-overlay/Kconfig
```kconfig
config SND_SOC_MODULE_OVERLAY_EXAMPLE
        tristate "module and device tree example"
        default n
        help
          buildroot.rockchip example kernel module and device tree
```

## package/gtkiostream/Config.in
```kconfig
config BR2_PACKAGE_GTKIOSTREAM
        bool "gtkiostream"
  depends on BR2_TOOLCHAIN_HAS_OPENMP
	select BR2_PACKAGE_EIGEN
  select BR2_PACKAGE_EIGEN_UNSUPPORTED_MODULES
	select BR2_PACKAGE_FFTW
  select BR2_PACKAGE_FFTW_DOUBLE
  select BR2_PACKAGE_FFTW_SINGLE
	select BR2_PACKAGE_ALSA_LIB
	select BR2_PACKAGE_LIBSAMPLERATE
  select BR2_PACKAGE_ALSA_UTILS
  select BR2_PACKAGE_ALSA_UTILS_AMIXER
  select BR2_PACKAGE_ALSA_UTILS_APLAY
  # The following are for sox
  select BR2_PACKAGE_FILE
  select BR2_PACKAGE_FLAC
  select BR2_PACKAGE_LAME
  select BR2_PACKAGE_LIBMAD
  select BR2_PACKAGE_LIBPNG
  select BR2_PACKAGE_LIBSNDFILE
  select BR2_PACKAGE_LIBVORBIS
  select BR2_PACKAGE_OPENCORE_AMR
  select BR2_PACKAGE_OPUSFILE
  select BR2_PACKAGE_LIBID3TAG
  select BR2_PACKAGE_LIBGSM
  select BR2_PACKAGE_LIBAO
  select BR2_PACKAGE_SOX
        help
          gtkiostream package

          https://github.com/flatmax/gtkiostream

comment "gtkiostream needs OpenMP"
	depends on !BR2_TOOLCHAIN_HAS_OPENMP
```

## package/libmraa/Config.in
```kconfig
config BR2_PACKAGE_LIBMRAA_ARCH_SUPPORTS
	bool
	default y if BR2_aarch64 || BR2_aarch64_be
	default y if BR2_arm || BR2_armeb
	default y if BR2_i386 || BR2_x86_64
	default y if BR2_mips || BR2_mipsel || BR2_mips64 || BR2_mips64el

config BR2_PACKAGE_LIBMRAA
	bool "radxa-mraa"
	depends on BR2_PACKAGE_LIBMRAA_ARCH_SUPPORTS
	depends on !BR2_STATIC_LIBS
	depends on BR2_TOOLCHAIN_HAS_THREADS
	help
		This package downloads a fork from Radxa development of the mraa 
    	library which adds support for pull-up resistors for Rock 3A.

comment "mraa needs a toolchain w/ threads, dynamic library"
	depends on BR2_PACKAGE_MRAA_ARCH_SUPPORTS
	depends on !BR2_TOOLCHAIN_HAS_THREADS || BR2_STATIC_LIBS
```

## package/libsox/Config.in
```kconfig
config BR2_PACKAGE_LIBSOX
	bool "libsox"
	select BR2_TOOLCHAIN_BUILDROOT_WCHAR
	select BR2_PACKAGE_ALSA_LIB_PCM
	select BR2_PACKAGE_FILE
	select BR2_PACKAGE_FLAC
	select BR2_PACKAGE_LAME
	select BR2_PACKAGE_LIBAO
	select BR2_PACKAGE_LIBID3TAG
	select BR2_PACKAGE_LIBMAD
	select BR2_PACKAGE_LIBPNG
	select BR2_PACKAGE_LIBSNDFILE
	select BR2_PACKAGE_LIBVORBIS
	select BR2_PACKAGE_OPENCORE_AMR
	select BR2_PACKAGE_OPUSFILE
	#select BR2_PACKAGE_PULSEAUDIO
	select BR2_PACKAGE_TWOLAME
	select BR2_PACKAGE_WAVPACK
	help
	  SoX is a cross-platform (Windows, Linux, MacOS X, etc.) command line
	  utility that can convert various formats of computer audio files
	  into other formats.
	  It can also apply various effects to these sound files, and, as an
	  added bonus, SoX can play and record audio files on most platforms.

	  http://sox.sourceforge.net/
```

## package/radxa-overlay/Config.in
```kconfig
config BR2_PACKAGE_RADXA_OVERLAY
        bool "radxa overlay"
        help
          Radxa device tree source files for Rockchip SoC boards
```

## package/rkbin3588/Config.in
```kconfig
config BR2_PACKAGE_RKBIN3588
        bool "rkbin3588"
        help
          Rockchip binary blobs
```

## package/rkdevice/Config.in
```kconfig
config BR2_PACKAGE_RKDEVICE
        bool "rktools"
        help
          Rockchip tools for image building
```

## package/rktools/Config.in
```kconfig
config BR2_PACKAGE_RKTOOLS
        bool "rktools"
        help
          Rockchip tools for image building
```

## package/rtk_hciattach/Config.in
```kconfig
config BR2_PACKAGE_RTK_HCIATTACH
        bool "rtl_hciattach"
        help
          rtl_hciattach package
```
