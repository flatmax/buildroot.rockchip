## configs/rock3a_defconfig
```kconfig
BR2_TARGET_GENERIC_HOSTNAME="rock3a"
BR2_TARGET_GENERIC_ISSUE="Welcome to the rock 3a board"

# board/compiler target setup
BR2_aarch64=y
BR2_cortex_a55=y
BR2_ARM_FPU_VFPV4=y
BR2_ARM_EABIHF=y

# Rock-Chip repos - mostly for sdcard image generation
BR2_PACKAGE_RKBIN=y

# post build sdcard image generaton
BR2_ROOTFS_POST_BUILD_SCRIPT="$(BR2_EXTERNAL)/board/RK3568/post-build.sh"
BR2_ROOTFS_POST_IMAGE_SCRIPT="$(BR2_EXTERNAL)/board/RK3568/post-image.sh"

# Filesystems
BR2_TARGET_ROOTFS_EXT2=y
BR2_TARGET_ROOTFS_EXT2_4=y
BR2_TARGET_ROOTFS_EXT2_SIZE="250M"
BR2_PACKAGE_HOST_DOSFSTOOLS=y
BR2_PACKAGE_HOST_MTOOLS=y
BR2_PACKAGE_HOST_UBOOT_TOOLS=y
BR2_PACKAGE_HOST_GENIMAGE=y

# u-boot
BR2_TARGET_UBOOT=y
BR2_TARGET_UBOOT_BUILD_SYSTEM_KCONFIG=y
BR2_TARGET_UBOOT_USE_DEFCONFIG=y
BR2_TARGET_UBOOT_CUSTOM_GIT=y
BR2_TARGET_UBOOT_CUSTOM_REPO_URL="https://github.com/radxa/u-boot.git"
BR2_TARGET_UBOOT_CUSTOM_REPO_VERSION="cd33ad23135a97a8df0931d221b076f3bc6241ce"
BR2_TARGET_UBOOT_BOARD_DEFCONFIG="rock-3a-rk3568"
BR2_TARGET_UBOOT_CUSTOM_MAKEOPTS="BL31=../rkbin-7d631e0d5b2d373b54d4533580d08fb9bd2eaad4/bin/rk35/rk3568_bl31_v1.24.elf spl/u-boot-spl.bin u-boot.dtb u-boot.itb"
BR2_TARGET_UBOOT_NEEDS_PYLIBFDT=y
BR2_TARGET_UBOOT_FORMAT_BIN=y
BR2_TARGET_UBOOT_FORMAT_IMG=n
BR2_TARGET_UBOOT_FORMAT_ITB=y
BR2_TARGET_UBOOT_SPL=y
BR2_TARGET_UBOOT_CONFIG_FRAGMENT_FILES="$(BR2_EXTERNAL)/board/RK3568/uboot.fragment"
BR2_PACKAGE_HOST_DTC=y

# linux
#BR2_PACKAGE_HOST_LIBYAML=y
BR2_LINUX_KERNEL=y
BR2_LINUX_KERNEL_PATCH=""
BR2_LINUX_KERNEL_CUSTOM_LOGO_PATH=""
BR2_LINUX_KERNEL_DTS_SUPPORT=y
BR2_LINUX_KERNEL_IMAGE=y
BR2_LINUX_KERNEL_GZIP=y
BR2_LINUX_KERNEL_DTB_OVERLAY_SUPPORT=y
BR2_LINUX_KERNEL_INTREE_DTS_NAME="rockchip/rk3568-rock-3a"

#BR2_LINUX_KERNEL_LATEST_VERSION=y
#BR2_LINUX_KERNEL_USE_ARCH_DEFAULT_CONFIG=y

BR2_LINUX_KERNEL_CUSTOM_VERSION=y
#BR2_LINUX_KERNEL_CUSTOM_VERSION_VALUE="5.19.17"
#BR2_KERNEL_HEADERS_5_19=y
BR2_LINUX_KERNEL_CUSTOM_VERSION_VALUE="6.0.9"
BR2_KERNEL_HEADERS_6_0=y
BR2_LINUX_KERNEL_USE_ARCH_DEFAULT_CONFIG=y

#BR2_LINUX_KERNEL_CUSTOM_GIT=y
#BR2_LINUX_KERNEL_CUSTOM_REPO_URL="https://github.com/radxa/kernel.git"
#BR2_LINUX_KERNEL_CUSTOM_REPO_VERSION="bac1feba87f09330afbd2083038319efd75642f8"
#BR2_KERNEL_HEADERS_4_19=y
#BR2_LINUX_KERNEL_USE_DEFCONFIG=y
#BR2_LINUX_KERNEL_DEFCONFIG="rockchip_linux"

# configure the place to source patches, the busybox frament, overlays
BR2_GLOBAL_PATCH_DIR="$(BR2_EXTERNAL)/patches.rock3a"
BR2_PACKAGE_BUSYBOX_CONFIG_FRAGMENT_FILES="$(BR2_EXTERNAL)/board/RK3568/busybox.fragment"
BR2_ROOTFS_OVERLAY="$(BR2_EXTERNAL)/overlays"

# where to store downloads
BR2_DL_DIR="$(BASE_DIR)/../../buildroot.dl"

# An example kernel module and devicetree overlay
#BR2_PACKAGE_EXAMPLE_MODULE_OVERLAY=y
BR2_LINUX_KERNEL_CONFIG_FRAGMENT_FILES=" $(BR2_EXTERNAL)/board/RK3568/kernel.fragment"

# external packages
BR2_PACKAGE_NTP=y
BR2_PACKAGE_NTP_NTPDATE=y

BR2_PACKAGE_OPENSSH=y
BR2_PACKAGE_OPENSSH_SERVER=y
BR2_PACKAGE_OPENSSH_CLIENT=y
BR2_SYSTEM_DHCP="eth0"
BR2_PACKAGE_AVAHI=y
BR2_PACKAGE_AVAHI_DAEMON=y

## Audio
#BR2_TOOLCHAIN_BUILDROOT_WCHAR=y
#BR2_PACKAGE_ALSA_UTILS=y
#BR2_PACKAGE_ALSA_UTILS_ALSAMIXER=y
#BR2_PACKAGE_ALSA_UTILS_AMIXER=y
#BR2_PACKAGE_ALSA_UTILS_APLAY=y
#BR2_PACKAGE_ALSA_UTILS_ALSACTL=y
#
#BR2_PACKAGE_DUMMY_SOUNDCARD=y
#
#BR2_TOOLCHAIN_BUILDROOT_CXX=y
#BR2_PACKAGE_JACK2=y

## desktop
BR2_ROOTFS_DEVICE_CREATION_DYNAMIC_EUDEV=y
BR2_TOOLCHAIN_BUILDROOT_WCHAR=y
BR2_PACKAGE_WESTON=y
BR2_PACKAGE_WESTON_DEFAULT_DRM=y
BR2_PACKAGE_WESTON_WAYLAND=y
BR2_PACKAGE_WESTON_SCRIPTS=y
BR2_PACKAGE_WESTON_SCRIPTS_INIT_WESTON=y
#BR2_PACKAGE_WESTON_DEMO_CLIENTS=y

BR2_PACKAGE_LIBERATION=y # fonts are necessary

BR2_TOOLCHAIN_BUILDROOT_CXX=y
BR2_PACKAGE_MESA3D=y
#BR2_PACKAGE_MESA3D_GALLIUM_DRIVER_SWRAST=y
BR2_PACKAGE_MESA3D_GALLIUM_DRIVER_PANFROST=y
BR2_PACKAGE_MESA3D_OPENGL_ES=y
BR2_PACKAGE_MESA3D_OPENGL_EGL=y

# wpewebkit and cog
#BR2_PACKAGE_GLIB_NETWORKING=y
#BR2_PACKAGE_SHARED_MIME_INFO=y
#BR2_PACKAGE_WPEWEBKIT=y
#BR2_PACKAGE_WPEWEBKIT_SANDBOX=y
#BR2_PACKAGE_COG=y
##BR2_PACKAGE_COG_PLATFORM_DRM=y

# wifi
BR2_PACKAGE_ARMBIAN_FIRMWARE=y
BR2_PACKAGE_ARMBIAN_FIRMWARE_AP6256=y
BR2_PACKAGE_WPA_SUPPLICANT=y
BR2_PACKAGE_WPA_SUPPLICANT_IBSS_RSN=y
BR2_PACKAGE_WPA_SUPPLICANT_AP_SUPPORT=y
BR2_PACKAGE_WPA_SUPPLICANT_AUTOSCAN=y
BR2_PACKAGE_WPA_SUPPLICANT_HOTSPOT=y
BR2_PACKAGE_WPA_SUPPLICANT_DEBUG_SYSLOG=y
BR2_PACKAGE_WPA_SUPPLICANT_WPS=y
BR2_PACKAGE_WPA_SUPPLICANT_WPA3=y
BR2_PACKAGE_WPA_SUPPLICANT_CLI=y
BR2_PACKAGE_WPA_SUPPLICANT_PASSPHRASE=y
BR2_PACKAGE_WPA_SUPPLICANT_WIFI_DISPLAY=y
```

## configs/rock5b_defconfig
```kconfig
BR2_TARGET_GENERIC_HOSTNAME="rock5b"
BR2_TARGET_GENERIC_ISSUE="Welcome to the rock5b board"

# board/compiler target setup
BR2_aarch64=y
BR2_cortex_a76_a55=y
BR2_ARM_FPU_FP_ARMV8=y
#BR2_ARM_EABIHF=y

# Rock-Chip repos - mostly for sdcard image generation
BR2_PACKAGE_RKBIN3588=y

# post build sdcard image generaton
BR2_ROOTFS_POST_BUILD_SCRIPT="$(BR2_EXTERNAL)/board/RK3588/post-build.sh"
BR2_ROOTFS_POST_IMAGE_SCRIPT="$(BR2_EXTERNAL)/board/RK3588/post-image.sh"
BR2_ROOTFS_POST_SCRIPT_ARGS="RK3566"

# Filesystems
BR2_TARGET_ROOTFS_EXT2=y
BR2_TARGET_ROOTFS_EXT2_4=y
BR2_TARGET_ROOTFS_EXT2_SIZE="250M"
BR2_PACKAGE_HOST_DOSFSTOOLS=y
BR2_PACKAGE_HOST_MTOOLS=y
BR2_PACKAGE_HOST_UBOOT_TOOLS=y
BR2_PACKAGE_HOST_GENIMAGE=y

# u-boot
BR2_TARGET_UBOOT=y
BR2_TARGET_UBOOT_BUILD_SYSTEM_KCONFIG=y
BR2_TARGET_UBOOT_USE_DEFCONFIG=y
BR2_TARGET_UBOOT_CUSTOM_GIT=y
BR2_TARGET_UBOOT_CUSTOM_REPO_URL="https://github.com/radxa/u-boot.git"
BR2_TARGET_UBOOT_CUSTOM_REPO_VERSION="stable-5.10-rock5"
BR2_TARGET_UBOOT_BOARD_DEFCONFIG="rock-5b-rk3588"
BR2_TARGET_UBOOT_CUSTOM_MAKEOPTS="BL31=../../images/rkbin/bin/rk35/rk3588_bl31_v1.26.elf spl/u-boot-spl.bin u-boot.dtb u-boot.itb"
BR2_TARGET_UBOOT_NEEDS_PYLIBFDT=y
BR2_TARGET_UBOOT_FORMAT_BIN=y
BR2_TARGET_UBOOT_FORMAT_IMG=n
BR2_TARGET_UBOOT_FORMAT_ITB=y
BR2_TARGET_UBOOT_SPL=y
BR2_TARGET_UBOOT_CONFIG_FRAGMENT_FILES="$(BR2_EXTERNAL)/board/RK3588/uboot.fragment"
BR2_PACKAGE_HOST_DTC=y

# linux
BR2_LINUX_KERNEL=y

BR2_LINUX_KERNEL_CUSTOM_GIT=y
BR2_LINUX_KERNEL_CUSTOM_REPO_URL="https://github.com/radxa/kernel.git"
#BR2_LINUX_KERNEL_CUSTOM_REPO_VERSION="stable-5.10-rock5"
BR2_LINUX_KERNEL_CUSTOM_REPO_VERSION="52f51a2b5ba178f331af62260d2da86d7472c14b"
BR2_LINUX_KERNEL_USE_DEFCONFIG=y
BR2_LINUX_KERNEL_DEFCONFIG="rockchip_linux"
BR2_LINUX_KERNEL_INTREE_DTS_NAME="rockchip/rk3588-rock-5b"
BR2_KERNEL_HEADERS_5_10=y

#BR2_LINUX_KERNEL_LATEST_VERSION=y
#BR2_LINUX_KERNEL_VERSION="5.18.9"
#BR2_LINUX_KERNEL_USE_ARCH_DEFAULT_CONFIG=y
#BR2_LINUX_KERNEL_INTREE_DTS_NAME="rockchip/rk3566-rock-cm3-e23-io"
#BR2_KERNEL_HEADERS_AS_KERNEL=y

BR2_LINUX_KERNEL_PATCH=""
BR2_LINUX_KERNEL_CUSTOM_LOGO_PATH=""
BR2_LINUX_KERNEL_DTS_SUPPORT=y
BR2_LINUX_KERNEL_IMAGE=y
BR2_LINUX_KERNEL_GZIP=y
BR2_LINUX_KERNEL_DTB_OVERLAY_SUPPORT=y

# configure the place to source patches, the busybox frament, overlays
BR2_GLOBAL_PATCH_DIR="$(BR2_EXTERNAL)/patches.rk3588"
BR2_PACKAGE_BUSYBOX_CONFIG_FRAGMENT_FILES="$(BR2_EXTERNAL)/board/RK3588/busybox.fragment"
BR2_ROOTFS_OVERLAY="$(BR2_EXTERNAL)/overlays"

# where to store downloads
BR2_DL_DIR="$(BASE_DIR)/../../buildroot.dl"

# An example kernel module and devicetree overlay
#BR2_PACKAGE_EXAMPLE_MODULE_OVERLAY=y
BR2_LINUX_KERNEL_CONFIG_FRAGMENT_FILES=" $(BR2_EXTERNAL)/board/RK3588/kernel.fragment"

# external packages
#BR2_PACKAGE_NTP=y
#BR2_PACKAGE_NTP_NTPDATE=y

BR2_PACKAGE_OPENSSH=y
BR2_PACKAGE_OPENSSH_SERVER=y
BR2_PACKAGE_OPENSSH_CLIENT=y
BR2_SYSTEM_DHCP="eth0"
BR2_PACKAGE_AVAHI=y
BR2_PACKAGE_AVAHI_DAEMON=y

## Audio
#BR2_TOOLCHAIN_BUILDROOT_WCHAR=y
#BR2_PACKAGE_ALSA_UTILS=y
#BR2_PACKAGE_ALSA_UTILS_ALSAMIXER=y
#BR2_PACKAGE_ALSA_UTILS_AMIXER=y
#BR2_PACKAGE_ALSA_UTILS_APLAY=y
#BR2_PACKAGE_ALSA_UTILS_ALSACTL=y
#
#BR2_PACKAGE_DUMMY_SOUNDCARD=y
#
#BR2_TOOLCHAIN_BUILDROOT_CXX=y
#BR2_PACKAGE_JACK2=y
```

## configs/rockN10_defconfig
```kconfig
BR2_TARGET_GENERIC_HOSTNAME="rockN10"
BR2_TARGET_GENERIC_ISSUE="Welcome to the rock Pi N10 board"

# board/compiler target setup
BR2_aarch64=y
BR2_cortex_a55=y
BR2_ARM_FPU_VFPV4=y
BR2_ARM_EABIHF=y

# Rock-Chip repos - mostly for sdcard image generation
BR2_PACKAGE_RKBIN=y
BR2_PACKAGE_RKDEVICE=y

# post build sdcard image generaton
BR2_ROOTFS_POST_BUILD_SCRIPT="$(BR2_EXTERNAL)/board/RK3399/post-build.sh"
BR2_ROOTFS_POST_IMAGE_SCRIPT="$(BR2_EXTERNAL)/board/RK3399/post-image.sh"
BR2_ROOTFS_POST_SCRIPT_ARGS="RK3399"

# Filesystems
BR2_TARGET_ROOTFS_EXT2=y
BR2_TARGET_ROOTFS_EXT2_4=y
BR2_TARGET_ROOTFS_EXT2_SIZE="250M"
BR2_PACKAGE_HOST_DOSFSTOOLS=y
BR2_PACKAGE_HOST_MTOOLS=y
BR2_PACKAGE_HOST_UBOOT_TOOLS=y
BR2_PACKAGE_HOST_GENIMAGE=y

# uboot
BR2_TARGET_UBOOT=y
BR2_TARGET_UBOOT_BUILD_SYSTEM_KCONFIG=y
#BR2_TARGET_UBOOT_NEEDS_PYTHON3=y
#BR2_TARGET_UBOOT_LATEST_VERSION=y
#BR2_TARGET_UBOOT_VERSION="2022.01"
#BR2_TARGET_UBOOT_BOARD_DEFCONFIG="rock-pi-n10-rk3399pro"
#BR2_TARGET_UBOOT_SPL=n

BR2_TARGET_UBOOT_CUSTOM_GIT=y
BR2_TARGET_UBOOT_CUSTOM_REPO_URL="https://github.com/radxa/u-boot.git"
BR2_TARGET_UBOOT_CUSTOM_REPO_VERSION="f18abd08ab7b374d3c9e3865cfa193d6113463b5"
BR2_TARGET_UBOOT_BOARD_DEFCONFIG="rk3399pro-rockpi-n10-linux"
BR2_TARGET_UBOOT_CUSTOM_MAKEOPTS="BL31=../rkbin-c3c03f6837ffd0b404a06136230edc0d768e1c7a/bin/rk33/rk3399pro_bl31_v1.35.elf spl/u-boot-spl.bin u-boot.dtb u-boot.itb"
BR2_TARGET_UBOOT_NEEDS_PYLIBFDT=y
#BR2_TARGET_UBOOT_NEEDS_PYTHON2=y
BR2_TARGET_UBOOT_FORMAT_ITB=y
BR2_TARGET_UBOOT_SPL=y

BR2_TARGET_UBOOT_NEEDS_DTC=y
BR2_TARGET_UBOOT_FORMAT_BIN=y
BR2_TARGET_UBOOT_FORMAT_IMG=n
BR2_TARGET_UBOOT_CONFIG_FRAGMENT_FILES="$(BR2_EXTERNAL)/board/RK3399/uboot.fragment"
BR2_PACKAGE_HOST_DTC=y

# linux
BR2_LINUX_KERNEL=y
BR2_LINUX_KERNEL_USE_ARCH_DEFAULT_CONFIG=y
BR2_LINUX_KERNEL_NEEDS_HOST_OPENSSL=y
BR2_LINUX_KERNEL_DTS_SUPPORT=y
BR2_LINUX_KERNEL_DTB_OVERLAY_SUPPORT=y

BR2_LINUX_KERNEL_LATEST_VERSION=y
BR2_TOOLCHAIN_HEADERS_LATEST=y
BR2_TOOLCHAIN_HEADERS_AT_LEAST="5.18"

BR2_LINUX_KERNEL_CUSTOM_VERSION=y
BR2_LINUX_KERNEL_CUSTOM_VERSION_VALUE="5.18.2"

BR2_LINUX_KERNEL_INTREE_DTS_NAME="rockchip/rk3399pro-rock-pi-n10"

# configure the place to source patches, the busybox frament, overlays
BR2_GLOBAL_PATCH_DIR="$(BR2_EXTERNAL)/patches.rockN10"
BR2_PACKAGE_BUSYBOX_CONFIG_FRAGMENT_FILES="$(BR2_EXTERNAL)/board/RK3399/busybox.fragment"
BR2_ROOTFS_OVERLAY="$(BR2_EXTERNAL)/overlays"

# where to store downloads
BR2_DL_DIR="$(BASE_DIR)/../../buildroot.dl"

# An example kernel module and devicetree overlay
#BR2_PACKAGE_EXAMPLE_MODULE_OVERLAY=y
BR2_LINUX_KERNEL_CONFIG_FRAGMENT_FILES=" $(BR2_EXTERNAL)/package/example-module-overlay/module-overlay-rk3308/kernel.fragment"
```

## configs/rockpie_defconfig
```kconfig
BR2_TARGET_GENERIC_HOSTNAME="RockPiE"
BR2_TARGET_GENERIC_ISSUE="Welcome to a RockPi E OS"

# board/compiler target setup
BR2_aarch64=y
BR2_cortex_a53=y
BR2_ARM_FPU_VFPV4=y
BR2_ARM_EABIHF=y

# toolchain for the older linux version
#BR2_GCC_VERSION_8_X=y

# Rock-Chip repos - mostly for sdcard image generation
BR2_PACKAGE_RKBIN=y
BR2_PACKAGE_RKTOOLS=y
BR2_PACKAGE_RKDEVICE=y

# post build sdcard image generaton
BR2_ROOTFS_POST_BUILD_SCRIPT="$(BR2_EXTERNAL)/board/RK3328/post-build.sh"
BR2_ROOTFS_POST_IMAGE_SCRIPT="$(BR2_EXTERNAL)/board/RK3328/post-image.sh"
BR2_ROOTFS_POST_SCRIPT_ARGS="RK3328"

# Filesystems
BR2_TARGET_ROOTFS_EXT2=y
BR2_TARGET_ROOTFS_EXT2_4=y
BR2_TARGET_ROOTFS_EXT2_SIZE="250M"
BR2_PACKAGE_HOST_DOSFSTOOLS=y
BR2_PACKAGE_HOST_MTOOLS=y
BR2_PACKAGE_HOST_UBOOT_TOOLS=y
BR2_PACKAGE_HOST_GENIMAGE=y

# u-boot
BR2_TARGET_UBOOT=y
BR2_TARGET_UBOOT_BUILD_SYSTEM_KCONFIG=y
BR2_TARGET_UBOOT_USE_DEFCONFIG=y
BR2_TARGET_UBOOT_LATEST_VERSION=y
#BR2_TARGET_UBOOT_CUSTOM_GIT=y
#BR2_TARGET_UBOOT_CUSTOM_REPO_URL="https://github.com/radxa/u-boot.git"
#BR2_TARGET_UBOOT_CUSTOM_REPO_VERSION="a94ab561e2f49a80d8579930e840b810ab1a1330"
BR2_TARGET_UBOOT_BOARD_DEFCONFIG="rock-pi-e-rk3328"
#BR2_TARGET_UBOOT_NEEDS_DTC=y
BR2_TARGET_UBOOT_NEEDS_PYLIBFDT=y
BR2_TARGET_UBOOT_NEEDS_PYTHON3=y
BR2_TARGET_UBOOT_FORMAT_BIN=y
BR2_TARGET_UBOOT_FORMAT_IMG=n
BR2_TARGET_UBOOT_SPL=n
BR2_TARGET_UBOOT_CONFIG_FRAGMENT_FILES="$(BR2_EXTERNAL)/board/RK3328/uboot.fragment"
BR2_PACKAGE_HOST_DTC=y

# ATF
BR2_TARGET_ARM_TRUSTED_FIRMWARE=y
BR2_TARGET_ARM_TRUSTED_FIRMWARE_LATEST_VERSION=y
BR2_TARGET_ARM_TRUSTED_FIRMWARE_PLATFORM="rk3328"
BR2_TARGET_ARM_TRUSTED_FIRMWARE_IMAGES=""

# linux
BR2_LINUX_KERNEL=y
BR2_LINUX_KERNEL_PATCH=""
#BR2_LINUX_KERNEL_CONFIG_FRAGMENT_FILES=""
BR2_LINUX_KERNEL_CUSTOM_LOGO_PATH=""
BR2_LINUX_KERNEL_DTS_SUPPORT=y
BR2_LINUX_KERNEL_IMAGE=y
BR2_LINUX_KERNEL_GZIP=y
BR2_LINUX_KERNEL_DTB_OVERLAY_SUPPORT=y

BR2_LINUX_KERNEL_CUSTOM_GIT=y
BR2_LINUX_KERNEL_CUSTOM_REPO_URL="https://kernel.googlesource.com/pub/scm/linux/kernel/git/stable/linux-stable"
BR2_LINUX_KERNEL_CUSTOM_REPO_VERSION="linux-5.11.y"
BR2_LINUX_KERNEL_USE_ARCH_DEFAULT_CONFIG=y
BR2_LINUX_KERNEL_INTREE_DTS_NAME="rockchip/rk3328-rock-pi-e"
#BR2_LINUX_KERNEL_DEFCONFIG="rk3308_linux"
#BR2_KERNEL_HEADERS_5_11=y
BR2_KERNEL_HEADERS_AS_KERNEL=y

# configure the place to source patches, the busybox frament, overlays
BR2_GLOBAL_PATCH_DIR="$(BR2_EXTERNAL)/patches.rockpie"
BR2_PACKAGE_BUSYBOX_CONFIG_FRAGMENT_FILES="$(BR2_EXTERNAL)/board/RK3328/busybox.fragment"
BR2_ROOTFS_OVERLAY="$(BR2_EXTERNAL)/overlays"

# where to store downloads
BR2_DL_DIR="$(BASE_DIR)/../../buildroot.dl"

# An example kernel module and devicetree overlay
#BR2_PACKAGE_EXAMPLE_MODULE_OVERLAY_5_11=y
#BR2_LINUX_KERNEL_CONFIG_FRAGMENT_FILES=" $(BR2_EXTERNAL)/package/example-module-overlay-5-11/module-overlay-rk3328/kernel.fragment"
BR2_PACKAGE_EXAMPLE_MODULE_OVERLAY=y
BR2_LINUX_KERNEL_CONFIG_FRAGMENT_FILES=" $(BR2_EXTERNAL)/package/example-module-overlay/module-overlay/kernel.fragment"
```
