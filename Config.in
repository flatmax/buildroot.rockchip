## configs/audioinjector_defconfig
```kconfig
#############################################
# audioinjector_custom_defconfig from here on
#
BR2_TARGET_GENERIC_HOSTNAME="audioinjector"
BR2_TARGET_GENERIC_ISSUE="Welcome to Audio Injector OS"

# where to store downloads
BR2_DL_DIR="$(BASE_DIR)/../../buildroot.dl"

# board setup
BR2_aarch64=y
BR2_cortex_a35=y

# Filesystem
BR2_TARGET_ROOTFS_EXT2=y
BR2_TARGET_ROOTFS_EXT2_4=y
BR2_TARGET_ROOTFS_EXT2_SIZE="250M"
BR2_PACKAGE_HOST_DOSFSTOOLS=y
BR2_PACKAGE_HOST_GENIMAGE=y
BR2_PACKAGE_HOST_MTOOLS=y
BR2_PACKAGE_HOST_UBOOT_TOOLS=y
#BR2_ROOTFS_POST_IMAGE_SCRIPT="support/scripts/genimage.sh"
#BR2_ROOTFS_POST_SCRIPT_ARGS="-c $(BR2_EXTERNAL)/board/RockPiS/genimage.cfg"
BR2_ROOTFS_POST_IMAGE_SCRIPT="$(BR2_EXTERNAL)/board/RockPiS/post-build.sh"
BR2_ROOTFS_POST_SCRIPT_ARGS="RK3308"

# gcc
#BR2_GCC_VERSION_8_X=y
#BR2_GCC_VERSION="8.4.0"

# ATF
BR2_TARGET_ARM_TRUSTED_FIRMWARE=y
BR2_TARGET_ARM_TRUSTED_FIRMWARE_LATEST_VERSION=y
BR2_TARGET_ARM_TRUSTED_FIRMWARE_VERSION="v2.2"
BR2_TARGET_ARM_TRUSTED_FIRMWARE_PLATFORM="rk3399"
BR2_TARGET_ARM_TRUSTED_FIRMWARE_BL31=n
BR2_TARGET_ARM_TRUSTED_FIRMWARE_BL31_UBOOT=n
BR2_TARGET_ARM_TRUSTED_FIRMWARE_BL32_DEFAULT=y
BR2_TARGET_ARM_TRUSTED_FIRMWARE_IMAGES="bl31/*.elf"
BR2_TARGET_ARM_TRUSTED_FIRMWARE_NEEDS_ARM32_TOOLCHAIN=y

# u-boot
BR2_TARGET_UBOOT=y
BR2_TARGET_UBOOT_BUILD_SYSTEM_KCONFIG=y
BR2_TARGET_UBOOT_LATEST_VERSION=y
BR2_TARGET_UBOOT_VERSION="2020.10"
BR2_TARGET_UBOOT_USE_DEFCONFIG=y
BR2_TARGET_UBOOT_BOARD_DEFCONFIG="roc-cc-rk3308"
BR2_TARGET_UBOOT_NEEDS_DTC=y
BR2_TARGET_UBOOT_FORMAT_BIN=n
BR2_TARGET_UBOOT_FORMAT_IMG=y
BR2_PACKAGE_HOST_DTC=y
BR2_TARGET_UBOOT_SPL=y
#BR2_TARGET_UBOOT_NEEDS_PYTHON3=y
BR2_TARGET_UBOOT_CONFIG_FRAGMENT_FILES="$(BR2_EXTERNAL)/board/RockPiS/uboot.fragment"

#BR2_TARGET_UBOOT=y
#BR2_TARGET_UBOOT_BUILD_SYSTEM_KCONFIG=y
#BR2_TARGET_UBOOT_CUSTOM_GIT=y
#BR2_TARGET_UBOOT_CUSTOM_REPO_URL="https://github.com/radxa/u-boot.git"
#BR2_TARGET_UBOOT_CUSTOM_REPO_VERSION="233a23e3ed0b3e5250253ee455c3c5df2080f99c"
## stable-4.4-rockpis 233a23e3ed0b3e5250253ee455c3c5df2080f99c
#BR2_TARGET_UBOOT_BOARD_DEFCONFIG="rock-pi-s-rk3308"
#BR2_TARGET_UBOOT_NEEDS_DTC=y
#BR2_TARGET_UBOOT_NEEDS_PYTHON3=y
#BR2_TARGET_UBOOT_NEEDS_ATF_BL31=y
#BR2_TARGET_UBOOT_NEEDS_ATF_BL31_ELF=y
#BR2_TARGET_UBOOT_FORMAT_CUSTOM=n
##BR2_TARGET_UBOOT_FORMAT_CUSTOM_NAME="u-boot.itb"
#BR2_TARGET_UBOOT_SPL=y
#BR2_TARGET_UBOOT_SPL_NAME="idbloader.img"

# linux
BR2_LINUX_KERNEL=y
BR2_LINUX_KERNEL_LATEST_VERSION=y
BR2_LINUX_KERNEL_VERSION="5.10"
BR2_LINUX_KERNEL_PATCH=""
#BR2_LINUX_KERNEL_USE_DEFCONFIG=y
#BR2_LINUX_KERNEL_DEFCONFIG=""
BR2_LINUX_KERNEL_CONFIG_FRAGMENT_FILES=""
BR2_LINUX_KERNEL_CUSTOM_LOGO_PATH=""
BR2_LINUX_KERNEL_IMAGE=y
BR2_LINUX_KERNEL_GZIP=y
BR2_LINUX_KERNEL_USE_CUSTOM_CONFIG=y
BR2_LINUX_KERNEL_CUSTOM_CONFIG_FILE="$(BR2_EXTERNAL)/board/RockPiS/rk3308_linux_defconfig"
BR2_LINUX_KERNEL_DTS_SUPPORT=y
#BR2_LINUX_KERNEL_DTB_IS_SELF_BUILT=y
BR2_LINUX_KERNEL_INTREE_DTS_NAME="rockchip/rk3308-roc-cc"

##BR2_KERNEL_HEADERS_4_4=y
##BR2_DEFAULT_KERNEL_HEADERS="4.4"
#BR2_KERNEL_HEADERS_AS_KERNEL=y
#BR2_PACKAGE_HOST_LINUX_HEADERS_CUSTOM_4_4=y

#BR2_LINUX_KERNEL=y
#BR2_LINUX_KERNEL_CUSTOM_GIT=y
#BR2_LINUX_KERNEL_CUSTOM_REPO_URL="git@github.com:radxa/kernel.git"
##BR2_LINUX_KERNEL_CUSTOM_REPO_VERSION="stable-4.4-rockpis"
##BR2_LINUX_KERNEL_CUSTOM_REPO_VERSION="cef30e88a9f56ca4fc5959a3ff442ce9b68f7501"
#BR2_LINUX_KERNEL_CUSTOM_REPO_VERSION="6b7accbc999b6caa8ef603b9d904c99694d0bf41"

#BR2_LINUX_KERNEL_VERSION="4.4"
#BR2_LINUX_KERNEL_USE_DEFCONFIG=y
#BR2_LINUX_KERNEL_DEFCONFIG="rk3308_linux"
#BR2_LINUX_KERNEL_IMAGE=y
#BR2_LINUX_KERNEL_GZIP=y

##BR2_LINUX_KERNEL_CONFIG_FRAGMENT_FILES="$(BR2_EXTERNAL)/package/audioinjector-alsa/audioinjector-allwinner/kernel.fragment"
##BR2_LINUX_KERNEL_CUSTOM_DTS_PATH="$(BR2_EXTERNAL)/package/audioinjector-alsa/audioinjector-allwinner/sun8i-h3-bananapi-m2-plus.dts"

# RK repos
BR2_PACKAGE_RKBIN=y
BR2_PACKAGE_RKTOOLS=y
BR2_PACKAGE_RKDEVICE=y

#BR2_TOOLCHAIN_BUILDROOT_WCHAR=y

BR2_GLOBAL_PATCH_DIR="$(BR2_EXTERNAL)/patches"

# package options
#BR2_PACKAGE_FFTW_USE_NEON=y
#BR2_PACKAGE_EIGEN_UNSUPPORTED_MODULES=y

BR2_PACKAGE_BUSYBOX_CONFIG_FRAGMENT_FILES="$(BR2_EXTERNAL)/configs/busybox.fragment"

# setup options
BR2_ROOTFS_OVERLAY="$(BR2_EXTERNAL)/overlays"
#BR2_ROOTFS_USERS_TABLES="$(BR2_EXTERNAL)/users.txt"

# audio drivers
#BR2_PACKAGE_AUDIOINJECTOR_ALSA=y

#BR2_TOOLCHAIN_BUILDROOT_WCHAR=y

BR2_GLOBAL_PATCH_DIR="$(BR2_EXTERNAL)/patches"

# buildroot packages

BR2_PACKAGE_BUSYBOX_CONFIG_FRAGMENT_FILES="$(BR2_EXTERNAL)/configs/busybox.fragment"

# setup options
BR2_ROOTFS_OVERLAY="$(BR2_EXTERNAL)/overlays"
#BR2_ROOTFS_USERS_TABLES="$(BR2_EXTERNAL)/users.txt"

# linux and device tree setup
#BR2_ROOTFS_DEVICE_CREATION_DYNAMIC_MDEV=y

#BR2_LINUX_KERNEL_DTS_SUPPORT=y
#BR2_LINUX_KERNEL_USE_CUSTOM_DTS=y
#BR2_LINUX_KERNEL_CUSTOM_DTS_PATH="$(BR2_EXTERNAL)/package/audioinjector-alsa/audioinjector-allwinner/sun8i-h3-bananapi-m2-plus.dts"
#BR2_LINUX_KERNEL_CONFIG_FRAGMENT_FILES="$(BR2_EXTERNAL)/package/audioinjector-alsa/audioinjector-allwinner/kernel.fragment"

# Firmware
#BR2_TARGET_ARM_TRUSTED_FIRMWARE=y
#BR2_TARGET_ARM_TRUSTED_FIRMWARE_CUSTOM_GIT=y
#BR2_TARGET_ARM_TRUSTED_FIRMWARE_CUSTOM_REPO_URL="https://github.com/apritzel/arm-trusted-firmware.git"
#BR2_TARGET_ARM_TRUSTED_FIRMWARE_PLATFORM="sun50iw1p1"
#BR2_TARGET_ARM_TRUSTED_FIRMWARE_CUSTOM_REPO_VERSION="aa75c8da415158a94b82a430b2b40000778e851f"
#BR2_TARGET_ARM_TRUSTED_FIRMWARE_BL31=y

# wifi firmware
#BR2_PACKAGE_ARMBIAN_FIRMWARE=y
#BR2_PACKAGE_ARMBIAN_FIRMWARE_AP6212=y

# networking packages

# wireless firmware
#BR2_PACKAGE_LINUX_FIRMWARE=y
#BR2_PACKAGE_LINUX_FIRMWARE_BRCM_BCM43XXX=y

# wireless tools
#BR2_PACKAGE_IW=y
#BR2_PACKAGE_WIRELESS_TOOLS=y
#BR2_PACKAGE_WIRELESS_TOOLS_LIB=y
#BR2_PACKAGE_WPA_SUPPLICANT=y
#BR2_PACKAGE_WPA_SUPPLICANT_NL80211=y
#BR2_PACKAGE_WPA_SUPPLICANT_CLI=y

#BR2_PACKAGE_OPENSSH=y
#BR2_PACKAGE_OPENSSH_SERVER=y
#BR2_PACKAGE_OPENSSH_CLIENT=y
#BR2_SYSTEM_DHCP="eth0"

#BR2_PACKAGE_NTP=y
#BR2_PACKAGE_NTP_NTPDATE=y

#BR2_PACKAGE_AVAHI=y
#BR2_PACKAGE_AVAHI_DAEMON=y

# audio stuff
#BR2_PACKAGE_ALSA_LIB=y
#BR2_PACKAGE_LIBSAMPLERATE=y
#BR2_PACKAGE_ALSA_UTILS=y
#BR2_PACKAGE_ALSA_UTILS_AMIXER=y
#BR2_PACKAGE_ALSA_UTILS_APLAY=y
#BR2_PACKAGE_ALSA_UTILS_ALSAMIXER=y
```

## configs/cm3_defconfig
```kconfig
BR2_TARGET_GENERIC_HOSTNAME="cm3"
BR2_TARGET_GENERIC_ISSUE="Welcome to the cm3 board"

# board/compiler target setup
BR2_aarch64=y
BR2_cortex_a55=y
BR2_ARM_FPU_VFPV4=y
BR2_ARM_EABIHF=y

# Rock-Chip repos - mostly for sdcard image generation
BR2_PACKAGE_RKBIN=y
BR2_PACKAGE_RKDEVICE=y

# post build sdcard image generaton
BR2_ROOTFS_POST_BUILD_SCRIPT="$(BR2_EXTERNAL)/board/RK3566.cm3/post-build.sh"
BR2_ROOTFS_POST_IMAGE_SCRIPT="$(BR2_EXTERNAL)/board/RK3566.cm3/post-image.sh"
BR2_ROOTFS_POST_SCRIPT_ARGS="RK3566"

# Filesystems
BR2_TARGET_ROOTFS_EXT2=y
BR2_TARGET_ROOTFS_EXT2_4=y
BR2_TARGET_ROOTFS_EXT2_SIZE="250M"
BR2_PACKAGE_HOST_DOSFSTOOLS=y
BR2_PACKAGE_HOST_MTOOLS=y
BR2_PACKAGE_HOST_UBOOT_TOOLS=y
BR2_PACKAGE_HOST_GENIMAGE=y

# u-boot
BR2_TARGET_UBOOT=y
BR2_TARGET_UBOOT_BUILD_SYSTEM_KCONFIG=y
BR2_TARGET_UBOOT_USE_DEFCONFIG=y
BR2_TARGET_UBOOT_CUSTOM_GIT=y
BR2_TARGET_UBOOT_CUSTOM_REPO_URL="https://github.com/radxa/u-boot.git"
BR2_TARGET_UBOOT_CUSTOM_REPO_VERSION="19cefea3b8a7e22fa29b39367b04a8ab90c5c765"
BR2_TARGET_UBOOT_BOARD_DEFCONFIG="radxa-cm3-io-rk3566"
BR2_TARGET_UBOOT_CUSTOM_MAKEOPTS="BL31=../rkbin-7d631e0d5b2d373b54d4533580d08fb9bd2eaad4/bin/rk35/rk3568_bl31_v1.24.elf spl/u-boot-spl.bin u-boot.dtb u-boot.itb"
BR2_TARGET_UBOOT_NEEDS_PYLIBFDT=y
BR2_TARGET_UBOOT_FORMAT_BIN=y
BR2_TARGET_UBOOT_FORMAT_IMG=n
BR2_TARGET_UBOOT_FORMAT_ITB=y
BR2_TARGET_UBOOT_SPL=y
BR2_TARGET_UBOOT_CONFIG_FRAGMENT_FILES="$(BR2_EXTERNAL)/board/RK3568/uboot.fragment"
BR2_PACKAGE_HOST_DTC=y

# uboot - modern version
#BR2_TARGET_UBOOT=y
#BR2_TARGET_UBOOT_BUILD_SYSTEM_KCONFIG=y
##BR2_TARGET_UBOOT_CUSTOM_VERSION=y
##BR2_TARGET_UBOOT_CUSTOM_VERSION_VALUE="2022.04"
#BR2_TARGET_UBOOT_CUSTOM_GIT=y
#BR2_TARGET_UBOOT_CUSTOM_REPO_URL="/home/flatmax/temp/u-boot"
#BR2_TARGET_UBOOT_CUSTOM_REPO_VERSION="HEAD"
##BR2_TARGET_UBOOT_CUSTOM_TARBALL=y
##BR2_TARGET_UBOOT_CUSTOM_TARBALL_LOCATION="/home/flatmax/temp/u-boot.tgz"
#
#BR2_TARGET_UBOOT_CUSTOM_MAKEOPTS="BL31=../rkbin-7d631e0d5b2d373b54d4533580d08fb9bd2eaad4/bin/rk35/rk3568_bl31_v1.24.elf"
#
#BR2_TARGET_UBOOT_BOARD_DEFCONFIG="radxa-cm3-io-rk3566"
#BR2_TARGET_UBOOT_NEEDS_DTC=y
#BR2_TARGET_UBOOT_NEEDS_PYTHON3=y
#
#BR2_TARGET_UBOOT_NEEDS_DTC=y
#BR2_TARGET_UBOOT_FORMAT_BIN=y
#BR2_TARGET_UBOOT_FORMAT_IMG=n
#BR2_TARGET_UBOOT_SPL=n
#BR2_TARGET_UBOOT_CONFIG_FRAGMENT_FILES="$(BR2_EXTERNAL)/board/RK3566.cm3/uboot.fragment"
#BR2_PACKAGE_HOST_DTC=y


# linux
BR2_LINUX_KERNEL=y

BR2_LINUX_KERNEL_CUSTOM_GIT=y
BR2_LINUX_KERNEL_CUSTOM_REPO_URL="https://github.com/radxa/kernel.git"
BR2_LINUX_KERNEL_CUSTOM_REPO_VERSION="0f91d24e217c2d146d0f82c1982b4b7d1c2e3573"
BR2_LINUX_KERNEL_USE_DEFCONFIG=y
BR2_LINUX_KERNEL_DEFCONFIG="rockchip_linux"
BR2_LINUX_KERNEL_INTREE_DTS_NAME="rockchip/rk3566-radxa-cm3-io"
BR2_KERNEL_HEADERS_4_19=y

#BR2_LINUX_KERNEL_LATEST_VERSION=y
#BR2_LINUX_KERNEL_VERSION="5.18.9"
#BR2_LINUX_KERNEL_USE_ARCH_DEFAULT_CONFIG=y
#BR2_LINUX_KERNEL_INTREE_DTS_NAME="rockchip/rk3566-rock-cm3-e23-io"
#BR2_KERNEL_HEADERS_AS_KERNEL=y

BR2_LINUX_KERNEL_PATCH=""
BR2_LINUX_KERNEL_CUSTOM_LOGO_PATH=""
BR2_LINUX_KERNEL_DTS_SUPPORT=y
BR2_LINUX_KERNEL_IMAGE=y
BR2_LINUX_KERNEL_GZIP=y
BR2_LINUX_KERNEL_DTB_OVERLAY_SUPPORT=y

# configure the place to source patches, the busybox frament, overlays
BR2_GLOBAL_PATCH_DIR="$(BR2_EXTERNAL)/patches.cm3"
BR2_PACKAGE_BUSYBOX_CONFIG_FRAGMENT_FILES="$(BR2_EXTERNAL)/board/RK3566.cm3/busybox.fragment"
BR2_ROOTFS_OVERLAY="$(BR2_EXTERNAL)/overlays"

# where to store downloads
BR2_DL_DIR="$(BASE_DIR)/../../buildroot.dl"

# An example kernel module and devicetree overlay
#BR2_PACKAGE_EXAMPLE_MODULE_OVERLAY=y
BR2_LINUX_KERNEL_CONFIG_FRAGMENT_FILES=" $(BR2_EXTERNAL)/package/example-module-overlay/module-overlay-rk3308/kernel.fragment"

# external packages
BR2_PACKAGE_NTP=y
BR2_PACKAGE_NTP_NTPDATE=y

BR2_PACKAGE_OPENSSH=y
BR2_PACKAGE_OPENSSH_SERVER=y
BR2_PACKAGE_OPENSSH_CLIENT=y
BR2_SYSTEM_DHCP="eth0"
BR2_PACKAGE_AVAHI=y
BR2_PACKAGE_AVAHI_DAEMON=y

## Audio
#BR2_TOOLCHAIN_BUILDROOT_WCHAR=y
#BR2_PACKAGE_ALSA_UTILS=y
#BR2_PACKAGE_ALSA_UTILS_ALSAMIXER=y
#BR2_PACKAGE_ALSA_UTILS_AMIXER=y
#BR2_PACKAGE_ALSA_UTILS_APLAY=y
#BR2_PACKAGE_ALSA_UTILS_ALSACTL=y
#
#BR2_PACKAGE_DUMMY_SOUNDCARD=y
#
#BR2_TOOLCHAIN_BUILDROOT_CXX=y
#BR2_PACKAGE_JACK2=y
```

## configs/quartz64_defconfig
```kconfig
BR2_TARGET_GENERIC_HOSTNAME="Quartz64"
BR2_TARGET_GENERIC_ISSUE="Welcome to a Quartz64 OS"

# board/compiler target setup
BR2_aarch64=y
BR2_cortex_a55=y
BR2_ARM_FPU_VFPV4=y
BR2_ARM_EABIHF=y

# Rock-Chip repos - mostly for sdcard image generation
BR2_PACKAGE_RKBIN=y
BR2_PACKAGE_RKTOOLS=y
BR2_PACKAGE_RKDEVICE=y

# post build sdcard image generaton
BR2_ROOTFS_POST_BUILD_SCRIPT="$(BR2_EXTERNAL)/board/RK3566/post-build.sh"
BR2_ROOTFS_POST_IMAGE_SCRIPT="$(BR2_EXTERNAL)/board/RK3566/post-image.sh"
BR2_ROOTFS_POST_SCRIPT_ARGS="RK3566"

# Filesystems
BR2_TARGET_ROOTFS_EXT2=y
BR2_TARGET_ROOTFS_EXT2_4=y
BR2_TARGET_ROOTFS_EXT2_SIZE="250M"
BR2_PACKAGE_HOST_DOSFSTOOLS=y
BR2_PACKAGE_HOST_MTOOLS=y
BR2_PACKAGE_HOST_UBOOT_TOOLS=y
BR2_PACKAGE_HOST_GENIMAGE=y

# u-boot
BR2_TARGET_UBOOT=y
BR2_TARGET_UBOOT_BUILD_SYSTEM_KCONFIG=y
BR2_TARGET_UBOOT_USE_DEFCONFIG=y
#BR2_TARGET_UBOOT_LATEST_VERSION=y
BR2_TARGET_UBOOT_CUSTOM_GIT=y
#BR2_TARGET_UBOOT_CUSTOM_REPO_URL="https://gitlab.com/pgwipeout/u-boot-rockchip.git"
#BR2_TARGET_UBOOT_CUSTOM_REPO_VERSION="quartz64"
BR2_TARGET_UBOOT_CUSTOM_REPO_URL="https://github.com/rockchip-linux/u-boot.git"
BR2_TARGET_UBOOT_CUSTOM_REPO_VERSION="next-dev"
BR2_TARGET_UBOOT_BOARD_DEFCONFIG="rk3566-quartz64"
BR2_TARGET_UBOOT_NEEDS_PYLIBFDT=y
BR2_TARGET_UBOOT_NEEDS_PYTHON3=y
BR2_TARGET_UBOOT_FORMAT_BIN=y
BR2_TARGET_UBOOT_FORMAT_IMG=n
BR2_TARGET_UBOOT_SPL=n
BR2_TARGET_UBOOT_CONFIG_FRAGMENT_FILES="$(BR2_EXTERNAL)/board/RK3566/uboot.fragment"
BR2_PACKAGE_HOST_DTC=y

# ATF
#BR2_TARGET_ARM_TRUSTED_FIRMWARE=y
#BR2_TARGET_ARM_TRUSTED_FIRMWARE_LATEST_VERSION=y
#BR2_TARGET_ARM_TRUSTED_FIRMWARE_PLATFORM="rk3566"
#BR2_TARGET_ARM_TRUSTED_FIRMWARE_IMAGES=""

# linux
BR2_PACKAGE_HOST_LIBYAML=y
BR2_LINUX_KERNEL=y
#BR2_LINUX_KERNEL_LATEST_VERSION=y
BR2_LINUX_KERNEL_CUSTOM_TARBALL=y
BR2_LINUX_KERNEL_CUSTOM_TARBALL_LOCATION="https://git.kernel.org/pub/scm/linux/kernel/git/torvalds/linux.git/snapshot/linux-5.16-rc2.tar.gz"
BR2_LINUX_KERNEL_VERSION="custom"
BR2_LINUX_KERNEL_PATCH=""
#BR2_LINUX_KERNEL_CONFIG_FRAGMENT_FILES=""
BR2_LINUX_KERNEL_CUSTOM_LOGO_PATH=""
BR2_LINUX_KERNEL_DTS_SUPPORT=y
BR2_LINUX_KERNEL_IMAGE=y
BR2_LINUX_KERNEL_GZIP=y
BR2_LINUX_KERNEL_DTB_OVERLAY_SUPPORT=y

BR2_LINUX_KERNEL_USE_ARCH_DEFAULT_CONFIG=y
BR2_LINUX_KERNEL_INTREE_DTS_NAME="rockchip/rk3566-quartz64-a"
#BR2_KERNEL_HEADERS_AS_KERNEL=y

# configure the place to source patches, the busybox frament, overlays
BR2_GLOBAL_PATCH_DIR="$(BR2_EXTERNAL)/patches.quartz64"
BR2_PACKAGE_BUSYBOX_CONFIG_FRAGMENT_FILES="$(BR2_EXTERNAL)/board/RK3566/busybox.fragment"
BR2_ROOTFS_OVERLAY="$(BR2_EXTERNAL)/overlays"

# where to store downloads
BR2_DL_DIR="$(BASE_DIR)/../../buildroot.dl"

# An example kernel module and devicetree overlay
#BR2_PACKAGE_EXAMPLE_MODULE_OVERLAY=y
BR2_LINUX_KERNEL_CONFIG_FRAGMENT_FILES=" $(BR2_EXTERNAL)/package/example-module-overlay/module-overlay/kernel.fragment"
```

## configs/rk3308_defconfig
```kconfig
BR2_TARGET_GENERIC_HOSTNAME="rk3308"
BR2_TARGET_GENERIC_ISSUE="Welcome to an rk3308 OS"

# board/compiler target setup
BR2_aarch64=y
BR2_cortex_a35=y

# Rock-Chip repos - mostly for sdcard image generation
BR2_PACKAGE_RKBIN=y
BR2_PACKAGE_RKTOOLS=y
BR2_PACKAGE_RKDEVICE=y

# post build sdcard image generaton
BR2_ROOTFS_POST_IMAGE_SCRIPT="$(BR2_EXTERNAL)/board/RK3308/post-build.sh"
BR2_ROOTFS_POST_SCRIPT_ARGS="RK3308"

# Filesystem
BR2_TARGET_ROOTFS_EXT2=y
BR2_TARGET_ROOTFS_EXT2_4=y
BR2_TARGET_ROOTFS_EXT2_SIZE="250M"
BR2_PACKAGE_HOST_DOSFSTOOLS=y
#BR2_PACKAGE_HOST_GENIMAGE=y # for now we aren't using gen image to make the sdcard, using rk binaries
BR2_PACKAGE_HOST_MTOOLS=y
BR2_PACKAGE_HOST_UBOOT_TOOLS=y

# u-boot
BR2_TARGET_UBOOT=y
BR2_TARGET_UBOOT_BUILD_SYSTEM_KCONFIG=y
BR2_TARGET_UBOOT_LATEST_VERSION=y
BR2_TARGET_UBOOT_VERSION="2020.10"
BR2_TARGET_UBOOT_USE_DEFCONFIG=y
BR2_TARGET_UBOOT_BOARD_DEFCONFIG="roc-cc-rk3308"
BR2_TARGET_UBOOT_NEEDS_DTC=y
BR2_TARGET_UBOOT_FORMAT_BIN=n
BR2_TARGET_UBOOT_FORMAT_IMG=y
BR2_TARGET_UBOOT_SPL=y
BR2_TARGET_UBOOT_CONFIG_FRAGMENT_FILES="$(BR2_EXTERNAL)/board/RK3308/uboot.fragment"
BR2_PACKAGE_HOST_DTC=y

# linux
BR2_LINUX_KERNEL=y
BR2_LINUX_KERNEL_LATEST_VERSION=y
BR2_LINUX_KERNEL_VERSION="5.10"
BR2_LINUX_KERNEL_PATCH=""
BR2_LINUX_KERNEL_CONFIG_FRAGMENT_FILES=""
BR2_LINUX_KERNEL_CUSTOM_LOGO_PATH=""
BR2_LINUX_KERNEL_IMAGE=y
BR2_LINUX_KERNEL_GZIP=y
BR2_LINUX_KERNEL_USE_CUSTOM_CONFIG=y
BR2_LINUX_KERNEL_CUSTOM_CONFIG_FILE="$(BR2_EXTERNAL)/board/RK3308/rk3308_linux_defconfig"
BR2_LINUX_KERNEL_DTS_SUPPORT=y
BR2_LINUX_KERNEL_INTREE_DTS_NAME="rockchip/rk3308-roc-cc"

# configure the place to source patches, the busybox frament, overlays
BR2_GLOBAL_PATCH_DIR="$(BR2_EXTERNAL)/patches"
BR2_PACKAGE_BUSYBOX_CONFIG_FRAGMENT_FILES="$(BR2_EXTERNAL)/board/RK3308/busybox.fragment"
BR2_ROOTFS_OVERLAY="$(BR2_EXTERNAL)/overlays"

# where to store downloads
#BR2_DL_DIR="$(BASE_DIR)/../../buildroot.dl"
```
